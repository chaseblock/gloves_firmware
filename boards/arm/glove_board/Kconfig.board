## boards/arm/glove_board/Kconfig.board
```kconfig
# Copyright (c) 2024 Nordic Semiconductor ASA
# SPDX-License-Identifier: Apache-2.0

config BOARD_GLOVE_BOARD
	bool "glove_board"
	depends on SOC_NRF52832_QFAA
```

## boards/arm/glove_board/Kconfig.defconfig
```kconfig
# Copyright (c) 2024 Nordic Semiconductor ASA
# SPDX-License-Identifier: Apache-2.0

if BOARD_GLOVE_BOARD

config BOARD
	default "glove_board"

config BT_CTLR
   default BT

endif
```
